## boards/shields/1st_ideal/Kconfig.defconfig
```kconfig
if SHIELD_1ST_IDEAL_LEFT

config ZMK_KEYBOARD_NAME
	default "1st Ideal"

config ZMK_SPLIT_ROLE_CENTRAL
	default y

endif

if SHIELD_1ST_IDEAL_LEFT || SHIELD_1ST_IDEAL_RIGHT

config ZMK_SPLIT
	default y

config I2C
	default y

config GPIO
	default y

endif
```

## boards/shields/1st_ideal/Kconfig.shield
```kconfig
config SHIELD_1ST_IDEAL_LEFT
	def_bool $(shields_list_contains,1st_ideal_left)

config SHIELD_1ST_IDEAL_RIGHT
	def_bool $(shields_list_contains,1st_ideal_right)
```
